## static_instrumentation_and_compilation/kernel_modifications/drivers/corrupter_module/Kconfig
```kconfig
config CORRUPTER_MODULE
	tristate "Enable corrupter and memory access tracer module"
	default y
	help
	  Select this to enable corrupter module.
```
